## build/conf/bblayers.conf
```bitbake
# POKY_BBLAYERS_CONF_VERSION is increased each time build/conf/bblayers.conf
# changes incompatibly
POKY_BBLAYERS_CONF_VERSION = "2"

BBPATH = "${TOPDIR}"
BBFILES ?= ""

BBLAYERS ?= " \
  /home/vboxuser/project_image/poky/meta \
  /home/vboxuser/project_image/poky/meta-poky \
  /home/vboxuser/project_image/poky/meta-yocto-bsp \
  /home/vboxuser/project_image/meta-openembedded/meta-oe \
  /home/vboxuser/project_image/meta-raspberrypi \
  /home/vboxuser/project_image/meta-vibration \
  /home/vboxuser/project_image/meta-tensorflow-lite \
  /home/vboxuser/project_image/meta-openembedded/meta-python \
  "
```

## meta-vibration/conf/layer.conf
```bitbake
# We have a conf and classes directory, add to BBPATH
BBPATH .= ":${LAYERDIR}"

# We have recipes-* directories, add to BBFILES
BBFILES += "${LAYERDIR}/recipes-*/*/*.bb \
            ${LAYERDIR}/recipes-*/*/*.bbappend"

BBFILE_COLLECTIONS += "meta-vibration"
BBFILE_PATTERN_meta-vibration = "^${LAYERDIR}/"
BBFILE_PRIORITY_meta-vibration = "6"

LAYERDEPENDS_meta-vibration = "core"
LAYERSERIES_COMPAT_meta-vibration = "scarthgap"
```
